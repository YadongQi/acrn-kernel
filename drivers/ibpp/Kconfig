## drivers/ibpp/Kconfig
```kconfig
#
# ImageBootParam Parse
#

menu "Image Boot Param Parse"

config IBPP
	bool "Image Boot Param Parse"
	depends on X86_64
	default n
endmenu
```

## drivers/tee_post_launch/Kconfig
```kconfig
#
# TEE Post Launch
#

menu "TEE Post Launch"

config TEE_POST_LAUNCH
	tristate "TEE Post Launch"
	depends on X86_64
	default n

endmenu
```
